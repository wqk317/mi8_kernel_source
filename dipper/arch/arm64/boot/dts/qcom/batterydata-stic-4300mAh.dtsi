/* Copyright (c) 2018-2020, The Linux Foundation. All rights reserved.
 * Copyright (C) 2020 Amktiao.
 *
 * This program is free software; you can redistribute it and/or modify
 * it under the terms of the GNU General Public License version 2 and
 * only version 2 as published by the Free Software Foundation.
 *
 * This program is distributed in the hope that it will be useful,
 * but WITHOUT ANY WARRANTY; without even the implied warranty of
 * MERCHANTABILITY or FITNESS FOR A PARTICULAR PURPOSE.  See the
 * GNU General Public License for more details.
 */

qcom,stic_4300mah {
	qcom,max-voltage-uv = <4430000>;
	qcom,fastchg-current-ma = <6000>;
	qcom,nom-batt-capacity-mah = <4300>;
	qcom,fg-cc-cv-threshold-mv = <4430>;
	qcom,batt-id-kohm = <80>;
	qcom,battery-beta = <3460>;
	qcom,battery-type = "stic_4300mah";
	qcom,jeita-fcc-ranges = <0   50   330000
			51  100  990000
			101  150  990000
			151 600  6000000
			601 650  1350000>;
	qcom,jeita-fv-ranges =  <0   50   6000000
			51  100  6000000
			101  150  6000000
			151 600  6000000
			601 650  2000000>;
	qcom,dynamic-fv-ranges = <0    100  4400000
			101  200  4430000
			201  300  4430000
			301  600  4430000
			601  650  4400000>;
	qcom,checksum = <0x3D0A>;
	qcom,gui-version = "PMI8998GUI - 2.0.0.58";
	qcom,fg-profile-data = [
		 2C 1F 3F FC
		 E9 03 A1 FD
		 58 1D FD F5
		 27 12 2C 14
		 3F 18 FF 22
		 9B 45 A3 52
		 55 00 00 00
		 0E 00 46 00
		 27 00 1C AC
		 F7 CD 71 B5
		 1A 00 0C 00
		 3C EB 54 E4
		 EC 05 7F FA
		 76 05 F5 02
		 CA F3 82 3A
		 2A 09 40 40
		 07 00 05 00
		 58 1F 42 06
		 85 03 35 F4
		 4D 1D 37 F2
		 23 0A 79 15
		 B7 18 32 23
		 26 45 72 53
		 55 00 00 00
		 0D 4F 00 00
		 00 00 13 CC
		 03 00 98 BD
		 16 00 00 00
		 3C EB 54 E4
		 9F FC A3 F3
		 0F FC DF FA
		 FF E5 A9 23
		 CB 33 08 33
		 07 10 00 00
		 81 0D 99 45
		 16 00 19 00
		 75 01 0A FA
		 FF 00 00 00
		 00 00 00 00
		 00 00 00 00
		 00 00 00 00
		 00 00 00 00
	];
};